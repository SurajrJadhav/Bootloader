//#define SERIAL_OUT

#ifdef SERIAL_OUT

#define SOH    'a'
#define STX   'b'
#define ACK   'd'
#define NAK   'e'
#define EOT   'f'
#define ETB   'g'
#define CANCEL  'h'
#define X_C   'C'

#else


#define SOH    0x01
#define STX   0x02
#define ACK   0x06
#define NAK   0x15
#define EOT   0x04
#define ETB   0x17
#define CANCEL  0x18
#define X_C   0x43

#endif

#define PKT_SIZE_1K 1024
#define PKT_SIZE 128

#define SWAP_BYTE(x) (x=((x&0x00ff)<<8) | ((x&0xff00)>>8))

uint8_t buf[6000]={0x00,0x00,0x02,0x20,0x0d,0x07,0x01,0x08,0x95,0x06,0x01,0x08,0x9b,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0xfa,
0x06,0xf3,0xf1,0x40,0x1f,0x43,0xc5,0xe9,0x00,0x71,0x00,0x26,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0x20,
0x04,0x00,0x00,0x20,0x80,0xb4,0x00,0xaf,0x06,0x4b,0x1b,0x78,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0x08,
0x02,0x33,0x52,0xf8,0x23,0x30,0xbb,0x61,0xfb,0x69,0x03,0xf0,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0x69,
0xd3,0x1a,0x02,0x2b,0x01,0xd9,0x03,0x23,0x67,0xe1,0x0b,0x4b,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0x68,
0x5b,0x68,0x9b,0x00,0x9a,0x42,0xeb,0xd1,0x25,0x4b,0x1b,0x68,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0x00,0xff};

bool send_flag=0;

void setup() {
  // put your setup code here, to run once:
  Serial.begin(115200);
  pinMode(0,INPUT);
  pinMode(LED_BUILTIN,OUTPUT);
  digitalWrite(LED_BUILTIN,LOW);
  
}

uint16_t xmodem_calcrc(unsigned char *ptr, int count)
{
  uint16_t  crc;
    char i;

    crc = 0;
    while (--count >= 0)
    {
        crc = crc ^ *ptr++ << 8;
        i = 8;
        do
        {
            if (crc & 0x8000)
                crc = crc << 1 ^ 0x1021;
            else
                crc = crc << 1;
        } while(--i);
    }
    SWAP_BYTE(crc);
    return (crc);
}
unsigned char * get_packet(int packet_num){
  static int last_pack=0;
  last_pack=(PKT_SIZE*(packet_num-1));
  if(last_pack < sizeof(buf))
    return buf+(PKT_SIZE*(packet_num-1));
  else
    return NULL;
}

unsigned char * get_packet_1k(int packet_num){
  static int last_pack=0;
  last_pack=(PKT_SIZE_1K*(packet_num-1));
  if(last_pack < sizeof(buf))
    return buf+(PKT_SIZE_1K*(packet_num-1));
  else
    return NULL;
}

void xmodem_wait_for_send(){
  unsigned char ch=0;
  while(ch!=X_C)
  {
    ch=Serial.read();
    wdt_reset();
  }
}

int pfile=0;
void send_file()
{
 
  Serial.print("1");
  delay(1000);
  int EOT_Flag=0,i,j;
  uint8_t _packet_num=1,_header;
  int _size;
  uint8_t *ptxbuf,response=0;
  if(_packet_num==1)
    xmodem_wait_for_send();
  do{

    /*start txn*/
    _size=PKT_SIZE_1K;
    _header=STX;
    
    ptxbuf=get_packet_1k(_packet_num);
    if(ptxbuf==NULL)
    {
      _header=EOT;
      EOT_Flag=1;
      break;
     }
    //send header
    Serial.write(_header);
    delay(1000);
    //send packet number;
    Serial.write(_packet_num);
    //send !(packet number)
    Serial.write(!_packet_num);
    //send data
    char temp[10];
    Serial.write(ptxbuf,_size);
#ifdef SERIAL_OUT
    for(int i=0;i<_size;i++)
    {
      sprintf(temp,"%p ",ptxbuf[i]);
      Serial.println("");
      Serial.println(temp);
      
      }
#endif
    //crc send
    uint16_t crc=xmodem_calcrc(ptxbuf, _size);
    Serial.write(crc);
//    delay(1000);
#ifdef SERIAL_OUT
    Serial.flush();
    //receive ACK or NAK
    Serial.println("");
    Serial.println("Enter ACK");
#endif

    while(response!=ACK){
      response=Serial.read();
      //reset watchdog-timer
      wdt_reset();
    }  
    if(response==ACK)
    {
      _packet_num++;
      response=0;     
    }
    else if(response==CANCEL){
        break;
     }
    
      
  }while(EOT_Flag==0);

  /*EOT of file*/
  uint8_t end_tx=EOT;
  Serial.write(end_tx);
  
#ifdef SERIAL_OUT  
  Serial.println("transmit completed!!!!");
#endif
}

void loop() {
  // put your main code here, to run repeatedly:
  /*write 1 to send signal of data read*/
  if(digitalRead(0)==LOW)
  {
    send_flag=1; 
    }
    else{
    send_flag=0;
      }

 if(send_flag==1)
{
  digitalWrite(LED_BUILTIN,HIGH);
  send_file();
  send_flag=0;
  digitalWrite(LED_BUILTIN,LOW);
}
 
}
